## Documentation/devicetree/bindings/nvmem/layouts/fixed-cell.yaml
```yaml
# SPDX-License-Identifier: (GPL-2.0-only OR BSD-2-Clause)
%YAML 1.2
---
$id: http://devicetree.org/schemas/nvmem/layouts/fixed-cell.yaml#
$schema: http://devicetree.org/meta-schemas/core.yaml#

title: Fixed offset & size NVMEM cell

maintainers:
  - Rafał Miłecki <rafal@milecki.pl>
  - Srinivas Kandagatla <srinivas.kandagatla@linaro.org>

properties:
  compatible:
    oneOf:
      - const: mac-base
        description: >
          Cell with base MAC address to be used for calculating extra relative
          addresses.
          It can be stored in a plain binary format (cell length 6) or as an
          ASCII text like "00:11:22:33:44:55" (cell length 17).

  reg:
    maxItems: 1

  bits:
    $ref: /schemas/types.yaml#/definitions/uint32-array
    items:
      - minimum: 0
        maximum: 31
        description:
          Offset in bit within the address range specified by reg.
      - minimum: 1
        description:
          Size in bit within the address range specified by reg.

  byte-map:
    $ref: /schemas/types.yaml#/definitions/uint32-array
    minItems: 1
    maxItems: 256
    description: |
      Ordered list of byte offsets within the address range specified by reg.
      The cell value contains the bytes at these offsets in the listed order.
      Offsets may be omitted, reordered, or repeated.

allOf:
  - not:
      required:
        - bits
        - byte-map
  - if:
      properties:
        compatible:
          contains:
            const: mac-base
      required: [ compatible ]
    then:
      properties:
        "#nvmem-cell-cells":
          description: The first argument is a MAC address offset.
          const: 1
      required:
        - "#nvmem-cell-cells"

required:
  - reg

additionalProperties: true
```
